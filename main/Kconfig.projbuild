## main/Kconfig.projbuild
```kconfig
menu "Clock Button Configuration"
config CLOCK_BUTTON_DEBUG
    bool "Enable physical button debug logs"
    default n
    help
        Log raw active-low GPIO levels, decoded press/release events, and
        normal/long actions. Enable only while diagnosing physical buttons.
endmenu

menu "Clock Network Configuration"
config ESP_WIFI_SSID
    string "Wi-Fi station SSID"
    default ""
    help
	SSID used only when the saved boot mode selects Wi-Fi. This value is
	compiled into the firmware; use it only where project configuration is
	appropriate for credential storage.

config ESP_WIFI_PASSWORD
    string "Wi-Fi station password"
    default ""
    help
	Password used by Wi-Fi station mode. It is never written to firmware logs.

config CLOCK_WIFI_EXPECTED_NETWORK
    string "Accepted Wi-Fi IPv4 network"
    default "192.168.0.0"
    help
	Network address that DHCP leases must belong to before Wi-Fi is considered
	online. Enter the network base address, not a host address. Example:
	192.168.0.0.

config CLOCK_WIFI_EXPECTED_NETMASK
    string "Accepted Wi-Fi IPv4 netmask"
    default "255.255.0.0"
    help
	Exact IPv4 netmask required for an accepted DHCP lease. Example:
	255.255.0.0.

config CLOCK_WIFI_EXPECTED_GATEWAY
    string "Accepted Wi-Fi IPv4 gateway"
    default "192.168.0.1"
    help
	Exact IPv4 default gateway required for an accepted DHCP lease. Example:
	192.168.0.1.

config CLOCK_NETWORK_ETH_TIMEOUT_MS
    int "Ethernet-only timeout (ms)"
    range 1000 60000
    default 15000

config CLOCK_NETWORK_WIFI_TIMEOUT_MS
    int "Wi-Fi-only timeout (ms)"
    range 1000 60000
    default 20000
endmenu
```

## sdkconfig.defaults
```kconfig
CONFIG_ESPTOOLPY_FLASHSIZE_16MB=y
CONFIG_PARTITION_TABLE_CUSTOM=y
CONFIG_PARTITION_TABLE_CUSTOM_FILENAME="partitions.csv"
CONFIG_BOOTLOADER_APP_ROLLBACK_ENABLE=y
CONFIG_ESP_HTTPS_OTA_ALLOW_HTTP=y
CONFIG_MBEDTLS_CERTIFICATE_BUNDLE=y
CONFIG_MBEDTLS_CERTIFICATE_BUNDLE_DEFAULT_FULL=y
# Wi-Fi DHCP lease acceptance policy (editable in menuconfig)
CONFIG_CLOCK_WIFI_EXPECTED_NETWORK="192.168.0.0"
CONFIG_CLOCK_WIFI_EXPECTED_NETMASK="255.255.0.0"
CONFIG_CLOCK_WIFI_EXPECTED_GATEWAY="192.168.0.1"
```
